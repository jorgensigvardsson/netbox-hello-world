## configs/hello-world_zero_defconfig
```kconfig
dbl From plat-zero.m4
BR2_x86_64=y
BR2_x86_corei7=y


dnl From base.m4
BR2_CCACHE=y
BR2_CCACHE_DIR="$(BR2_EXTERNAL_HELLO_WORLD_PATH)/.buildroot-ccache"
BR2_CCACHE_INITIAL_SETUP=""
BR2_CCACHE_USE_BASEDIR=y
BR2_ENABLE_DEBUG=y
BR2_DL_DIR="$(BR2_EXTERNAL_HELLO_WORLD_PATH)/dl"
BR2_GLOBAL_PATCH_DIR="$(BR2_EXTERNAL_NETBOX_PATH)/patches"
BR2_TARGET_GENERIC_HOSTNAME="hello-world"
BR2_TARGET_GENERIC_ISSUE="HelloWorld - The HelloWorld of Netbox"
BR2_INIT_NONE=y
BR2_ROOTFS_POST_BUILD_SCRIPT="$(BR2_EXTERNAL_HELLO_WORLD_PATH)/board/common/post-build.sh"
BR2_ROOTFS_POST_IMAGE_SCRIPT="$(BR2_EXTERNAL_HELLO_WORLD_PATH)/board/common/post-image.sh $(BR2_EXTERNAL_HELLO_WORLD_PATH)/board/zero/post-image.sh "
BR2_PACKAGE_BUSYBOX_CONFIG="$(BR2_EXTERNAL_HELLO_WORLD_PATH)/board/common/busybox.config"
BR2_PACKAGE_BUSYBOX_SHOW_OTHERS=y
BR2_TARGET_ROOTFS_SQUASHFS=y
BR2_PACKAGE_HOST_GENIMAGE=y
BR2_PACKAGE_HOST_GENEXT2FS=y
BR2_PACKAGE_HOST_SQUASHFS=y

dnl From toolchain-bootlin.m4
BR2_TOOLCHAIN_EXTERNAL=y
BR2_TOOLCHAIN_EXTERNAL_BOOTLIN=y
BR2_TOOLCHAIN_EXTERNAL_GDB_SERVER_COPY=y


dnl From os.m4
BR2_LINUX_KERNEL=y
BR2_LINUX_KERNEL_CUSTOM_VERSION=y
BR2_LINUX_KERNEL_CUSTOM_VERSION_VALUE="5.14.3"
BR2_LINUX_KERNEL_USE_CUSTOM_CONFIG=y
BR2_LINUX_KERNEL_CUSTOM_CONFIG_FILE="$(BR2_EXTERNAL_NETBOX_PATH)/board/$(NETBOX_PLAT)/linux_defconfig"
BR2_LINUX_KERNEL_INSTALL_TARGET=y

dnl OS profile selects the following packages
NETBOX_TYPE_OS=y
BR2_PACKAGE_TETRIS=y
BR2_PACKAGE_FINIT=y
BR2_PACKAGE_DNSMASQ=y
BR2_PACKAGE_DROPBEAR=y
BR2_PACKAGE_ETHTOOL=y
BR2_PACKAGE_EVTEST=y
BR2_PACKAGE_INADYN=y
BR2_PACKAGE_IPERF=y
BR2_PACKAGE_IPROUTE2=y
BR2_PACKAGE_LIBCURL=y
BR2_PACKAGE_LIBGPIOD=y
BR2_PACKAGE_LIBGPIOD_TOOLS=y
BR2_PACKAGE_LIBNL=y
BR2_PACKAGE_LLDPD=y
BR2_PACKAGE_LM_SENSORS=y
BR2_PACKAGE_MCJOIN=y
BR2_PACKAGE_MDIO_TOOLS=y
BR2_PACKAGE_MG=y
BR2_PACKAGE_NEMESIS=y
BR2_PACKAGE_NETCALC=y
BR2_PACKAGE_NFTABLES=y
BR2_PACKAGE_QUAGGA=y
BR2_PACKAGE_QUAGGA_ZEBRA=y
BR2_PACKAGE_QUAGGA_ISISD=y
BR2_PACKAGE_QUAGGA_OSPFD=y
BR2_PACKAGE_QUAGGA_OSPF6D=y
BR2_PACKAGE_QUAGGA_RIPD=y
BR2_PACKAGE_QUAGGA_RIPNGD=y
BR2_PACKAGE_QUAGGA_VTYSH=y
BR2_PACKAGE_SMCROUTE=y
BR2_PACKAGE_SOCAT=y
BR2_PACKAGE_SSDP_RESPONDER=y
BR2_PACKAGE_STRESS_NG=y
BR2_PACKAGE_SYSKLOGD=y
BR2_PACKAGE_SYSKLOGD_LOGGER=y
BR2_PACKAGE_TCPDUMP=y
BR2_PACKAGE_WATCHDOGD=y


BR2_LINUX_KERNEL_NEEDS_HOST_LIBELF=y
dnl Disable host openssl for now, fails in release builds
dnl BR2_LINUX_KERNEL_NEEDS_HOST_OPENSSL=y
```

## package/hello-world/Config.in
```kconfig
config BR2_PACKAGE_HELLO_WORLD
	bool "helloworld"
	help
	  Runs hello world in a very overly complex manner.
```
